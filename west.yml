## west.yml
```yaml
manifest:
  remotes:
    - name: zephyr
      url-base: git@github.com:zephyrproject-rtos

  projects:
    - name: zephyr
      remote: zephyr
      revision: v3.7.0
      import:
        name-allowlist:
          - cmsis
          - hal_nxp
```
